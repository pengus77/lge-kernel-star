## drivers/misc/kowalski/Kconfig
```kconfig
#
# Kowalski Kernel Optimizations
#

menuconfig KOWALSKI
	bool "Kowalski Kernel Optimizations"
	depends on EXPERIMENTAL
	default yes
	help
	  This option enables support for specific Kowalski
	  Kernel Optimizations.

if KOWALSKI

config KOWALSKI_FAST_CHARGE
	bool "Simulate AC charging mode on USB"
	default n
	help
	  A simple sysfs interface to force adapters that
	  are detected as USB to charge as AC.

config KOWALSKI_WIFI_PM
	bool "Enable WiFi Extended Power Management"
	default y
	help
	  This will enable a set of sysfs entries allowing
	  the configuration of the wifi pm modes from user
	  space.

config KOWALSKI_OC
	bool "Enable Overclocking"
	depends on TEGRA_CPU_DVFS && TEGRA_CORE_DVFS
	default n

config KOWALSKI_MAX_OC
	bool "Enable Extreme Overclocking (above 1.25)"
	depends on KOWALSKI_OC
	default n

config KOWALSKI_UV
	bool "Enable Voltage Control"
	depends on TEGRA_CPU_DVFS && TEGRA_CORE_DVFS
	default n

config KOWALSKI_CPU_SUSPEND_FREQ_LIMIT
	bool "Enable CPU Clock Frequency Limit in Suspend"
	depends on TEGRA_CPU_DVFS && TEGRA_CORE_DVFS
	default n

endif # KOWALSKI
```
